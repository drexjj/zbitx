#include <stdio.h>
#include <linux/types.h>
#include <stdint.h>
#include <string.h>
#include <wiringPi.h>
#include "i2cbb.h"
#include "oled.h"

/* 
The oled framebuffer is divided into 8 pages, top to bottom.
Each page is 8 rows wide. Each vertical row is represented by a byte
*/

#define SDA 23 
#define SCL 22

static uint8_t oled_bmp[10000];
static uint8_t oled_pages = 8; 

// 6x8 technoblogy font
const static uint8_t font[] = {
   0x00, 0x00, 0x00, 0x00, 0x00, 0x00, 
   0x00, 0x00, 0x5F, 0x00, 0x00, 0x00, 
   0x00, 0x07, 0x00, 0x07, 0x00, 0x00, 
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   0xFF, 0xFF, 0xFF, 0xFF, 0xFF, 0x00 };

void oled_refresh() {
  uint8_t renderingFrame = 0xB0;
	uint8_t oled_sequence[4]; 
	int i = 0;

	for (uint8_t i = 0; i < oled_pages; i++){
		oled_sequence[0] = 0xB0 | i;
		oled_sequence[1] = 0x0;
		oled_sequence[2] = 0x10;

 		int e = i2cbb_write_i2c_block_data (OLED_ADDR, OLED_COMMAND, 4, oled_sequence);
		if (e)
			printf("oled_write: error writing ssd1306 register at %d index\n", e);
	
 		e = i2cbb_write_i2c_block_data (OLED_ADDR, OLED_DATA, 128, oled_bmp + (i * 128));
		if (e)
			printf("oled_write: error writing ssd1306 frame buffer at %d index\n", e);
	}
	
}


int oled_init(){
  i2cbb_init(SDA, SCL); //just in case...
 	int e = i2cbb_write_i2c_block_data (OLED_ADDR, OLED_COMMAND, sizeof(oled_init_sequence), oled_init_sequence);
	if (e){
		printf("oled display not detected\n");
		return -1;
	}
	return 0;
}

const char *oled_write(uint8_t col, uint8_t row, const char *string){
	int offset = (128 * row) + col + 2;
	uint8_t *b = oled_bmp + offset;

	while(*string >= ' '){
		const uint8_t *f = font + ((*string-32) * 6);
		for (int j = 0; j < 6; j++)
			*b++ = *f++;	
		string++;
	}
	return string;
}

#define MAX_LINES 100
#define MAX_COLS 20
static char circular_buffer[MAX_COLS * MAX_LINES];

void oled_console(int style, char *string){
	
}
void oled_clear(){
	memset(oled_bmp, 0, sizeof(oled_bmp));
}
/*
int main(int argc, char **argvc){
	wiringPiSetup();
  i2cbb_init(SDA, SCL);
	delay(10);

	oled_init();
	delay(100);
	memset(oled_bmp, 0, sizeof(oled_bmp));
//	memset(oled_bmp+512, 0xff, 128);
	oled_refresh();
	delay(1000);
	oled_write(3,1, "1234567890123456");
	oled_refresh();
}
*/
